## drivers/entropy/Kconfig.aspeed
```kconfig
# Copyright (c) 2026 ASPEED Technology Inc.
# SPDX-License-Identifier: Apache-2.0

config ENTROPY_AST27XX_RNG
	bool "ASPEED AST27XX RNG entropy driver"
	default y
	depends on DT_HAS_ASPEED_AST2700_RNG_ENABLED
	select ENTROPY_HAS_DRIVER
	select SYSCON
	help
	  Enable the SCU1 random number generator driver for ASPEED AST2700.
```

## drivers/mbox/Kconfig.aspeed
```kconfig
# Copyright (c) 2026 ASPEED Technology Inc.
# SPDX-License-Identifier: Apache-2.0

menuconfig MBOX_AST27XX
	bool "ASPEED AST27xx MBOX driver"
	default y
	depends on DT_HAS_ASPEED_AST2700_MAILBOX_ENABLED
	help
	  Enable the AST2700 mailbox controller with four 32-byte channels per
	  peer. All instances share a polling thread. Callbacks execute in this
	  driver thread, rather than in interrupt context, and may use blocking
	  APIs. A callback delays polling of all channels until it returns.

if MBOX_AST27XX

config MBOX_AST27XX_POLL_INTERVAL_MS
	int "Polling interval in milliseconds"
	default 1
	range 1 1000
	help
	  Interval between mailbox checks while any receive channel is enabled.
	  The polling thread sleeps on a semaphore when all channels are disabled.

config MBOX_AST27XX_THREAD_STACK_SIZE
	int "Polling thread stack size"
	default 1024
	help
	  Stack size in bytes for the shared polling thread and its callbacks.

config MBOX_AST27XX_THREAD_PRIORITY
	int "Polling thread priority"
	default 0
	help
	  Priority of the shared polling thread that executes receive callbacks.

endif # MBOX_AST27XX
```

## drivers/mspi/Kconfig.aspeed
```kconfig
# Copyright (c) 2026 ASPEED Technology Inc.
#
# SPDX-License-Identifier: Apache-2.0

menuconfig MSPI_AST27XX_FMC
	bool "ASPEED AST2700 FMC MSPI controller driver"
	default y
	depends on DT_HAS_ASPEED_AST2700_FMC_ENABLED
	select CLOCK_CONTROL
	select PINCTRL if $(dt_compat_any_has_prop,$(DT_COMPAT_ASPEED_AST2700_FMC),pinctrl-0)
	help
	  Enable polling transfers through the AST2700 firmware SPI flash
	  controller. Supports single I/O on CE0 with 3-byte or 4-byte addresses.

if MSPI_AST27XX_FMC

config MSPI_AST27XX_FMC_DMA
	bool "DMA reads"
	default y
	depends on MSPI_DMA
	help
	  Use the controller's internal DMA engine for aligned reads larger than
	  128 bytes. Other transfers use programmed I/O, including DMA requests
	  that do not meet the controller's constraints. Completion is polled.

endif # MSPI_AST27XX_FMC
```

## drivers/otp/Kconfig.aspeed
```kconfig
# Copyright (c) 2026 ASPEED Technology Inc.
# SPDX-License-Identifier: Apache-2.0

config OTP_AST27XX
	bool "ASPEED AST27xx OTP driver"
	default y
	depends on DT_HAS_ASPEED_AST2700_OTP_ENABLED
	help
	  Enable read-only access to the ASPEED AST2700 OTP controller.
```

## drivers/pinctrl/Kconfig.aspeed
```kconfig
# Copyright (c) 2026 ASPEED Technology Inc.
#
# SPDX-License-Identifier: Apache-2.0

config PINCTRL_AST27XX_SOC1
	bool "ASPEED AST27xx SoC1 pin controller driver"
	default y
	depends on DT_HAS_ASPEED_AST2700_SOC1_PINCTRL_ENABLED
	select SYSCON
	help
	  Enable pin control for the AST2700 I/O die through the SCU1 syscon.
```

## drivers/watchdog/Kconfig.aspeed
```kconfig
# Copyright (c) 2026 ASPEED Technology Inc.
# SPDX-License-Identifier: Apache-2.0

config WDT_AST27XX
	bool "ASPEED AST27xx watchdog driver"
	default y
	depends on DT_HAS_ASPEED_AST2700_WDT_ENABLED
	select HAS_WDT_DISABLE_AT_BOOT
	select HAS_WDT_NO_CALLBACKS
	help
	  Enable the watchdog driver for ASPEED AST27xx SoCs. Only SoC reset
	  without an interrupt callback is supported.
```

## dts/bindings/clock/aspeed,ast27xx-scu0-clock.yaml
```yaml
# Copyright (c) 2026 ASPEED Technology Inc.
# SPDX-License-Identifier: Apache-2.0

description: |
  ASPEED AST27XX SCU0 clock controller.

  The node is a child of the SCU0 syscon node, whose register block holds the
  clock stop, clock select and PLL registers. The clock specifier cell is an
  ID from include/zephyr/dt-bindings/clock/ast27xx_clock.h.

compatible: "aspeed,ast27xx-scu0-clock"

include: [clock-controller.yaml, base.yaml]

properties:
  "#clock-cells":
    const: 1

clock-cells:
  - clkid
```

## dts/bindings/mbox/aspeed,ast2700-mailbox.yaml
```yaml
# Copyright (c) 2026 ASPEED Technology Inc.
# SPDX-License-Identifier: Apache-2.0

description: |
  ASPEED AST2700 mailbox controller. Each node describes a pair of TX and
  RX register blocks for communication with one peer. Each direction has
  four channels with 32 bytes of message data per channel. BootMCU uses
  polling to receive messages.

compatible: "aspeed,ast2700-mailbox"

include: [base.yaml, mailbox-controller.yaml]

properties:
  reg:
    required: true
    description: TX register block followed by RX register block, each 0x100 bytes.

  reg-names:
    required: true
    description: Names of the two register blocks, in order "tx", "rx".

  "#mbox-cells":
    const: 1

mbox-cells:
  - channel
```

## dts/bindings/mspi/aspeed,ast2700-fmc.yaml
```yaml
# Copyright (c) 2026 ASPEED Technology Inc.
#
# SPDX-License-Identifier: Apache-2.0

description: ASPEED AST2700 firmware SPI flash controller

compatible: "aspeed,ast2700-fmc"

include: [mspi-controller.yaml, pinctrl-device.yaml]

properties:
  reg:
    required: true
    description: Controller registers followed by the CE0 AHB data window.

  clocks:
    required: true
    description: HCLK source clock.

  clock-names:
    required: true
    description: Name of the HCLK source clock, hclk.

  num-cs:
    type: int
    required: true
    const: 1
    description: Number of supported chip selects. Only CE0 is supported.

  packet-data-limit:
    default: 33554432
    description: |
      Maximum data length per packet. The default is the 32 MiB limit of the
      controller's 25-bit DMA length register. A smaller limit can be used to
      bound the duration of a single transaction.
```

## dts/bindings/otp/aspeed,ast2700-otp.yaml
```yaml
# Copyright (c) 2026 ASPEED Technology Inc.
# SPDX-License-Identifier: Apache-2.0

description: ASPEED AST2700 OTP controller

compatible: "aspeed,ast2700-otp"

include: base.yaml

properties:
  reg:
    required: true
```

## dts/bindings/pinctrl/aspeed,ast2700-soc1-pinctrl.yaml
```yaml
# Copyright (c) 2026 ASPEED Technology Inc.
#
# SPDX-License-Identifier: Apache-2.0

description: |
  ASPEED AST2700 SoC1 (I/O die) pin controller, a child of the SCU1 syscon.

  Each child describes a state containing groups of pins. Each group has a
  pinmux array of 32-bit cells built with AST27XX_SOC1_PINMUX(ball, func) or
  the named signal macros from
  <zephyr/dt-bindings/pinctrl/ast27xx-soc1-pinctrl.h>. Bits [15:8] identify
  the ball, bits [2:0] select its function, and all other bits must be zero.
  Ball indices are C25=0, C24=1, A17=2, A16=3, M16=4 and A15=5.
  M16 and A15 support function 0 (GPIO) and 1 (FWSPIDQ2 and FWSPIDQ3).
  Dedicated FWSPI pins use function 0 without programming a mux register.

  Groups may specify bias-disable for M16 and A15, and aspeed,drive-strength
  for all supported balls. Omitted properties leave the corresponding
  hardware settings unchanged.

compatible: "aspeed,ast2700-soc1-pinctrl"

include: base.yaml

child-binding:
  description: Pin configuration state.

  child-binding:
    description: Pins sharing configuration properties.

    include:
      - name: pincfg-node.yaml
        property-allowlist:
          - bias-disable

    properties:
      pinmux:
        type: array
        required: true
        description: Ball and function selections for this group.

      aspeed,drive-strength:
        type: int
        enum: [0, 1, 2, 3]
        description: |
          Output drive strength level, from 0 (weakest) to 3 (strongest).
          These levels do not specify a current in milliamperes.
```

## dts/bindings/reset/aspeed,ast27xx-reset.yaml
```yaml
# Copyright (c) 2026 ASPEED Technology Inc.
# SPDX-License-Identifier: Apache-2.0

description: |
  ASPEED AST27XX reset controller.

  The node is a child of an SCU0 or SCU1 syscon node, whose register block
  holds the reset control and clear registers. The reset specifier cell is
  an ID from include/zephyr/dt-bindings/reset/ast27xx_reset.h.

compatible: "aspeed,ast27xx-reset"

include: [reset-controller.yaml, base.yaml]

properties:
  "#reset-cells":
    const: 1

reset-cells:
  - id
```

## dts/bindings/rng/aspeed,ast2700-rng.yaml
```yaml
# Copyright (c) 2026 ASPEED Technology Inc.
# SPDX-License-Identifier: Apache-2.0

description: |
  ASPEED AST2700 SCU1 random number generator.

  This node is a child of the SCU1 syscon node and has no reg property.
  The RNG registers are accessed through the parent syscon.

compatible: "aspeed,ast2700-rng"

include: base.yaml
```

## dts/bindings/watchdog/aspeed,ast2700-wdt.yaml
```yaml
# Copyright (c) 2026 ASPEED Technology Inc.
# SPDX-License-Identifier: Apache-2.0

description: ASPEED AST2700 watchdog timer

compatible: "aspeed,ast2700-wdt"

include: base.yaml

properties:
  reg:
    required: true
```
