## drivers/pinctrl/Kconfig.aspeed
```kconfig
# Copyright (c) 2026 ASPEED Technology Inc.
#
# SPDX-License-Identifier: Apache-2.0

config PINCTRL_ASPEED_G7
	bool "ASPEED G7 pin controller driver"
	default y
	depends on DT_HAS_ASPEED_AST2700_SOC1_PINCTRL_ENABLED
	select SYSCON
	help
	  Enable the pin controller driver for ASPEED G7 SoCs, which programs
	  the SCU fields that the devicetree pin nodes describe.

config PINCTRL_ASPEED_G7_CONFLICT_CHECK
	bool "Reject conflicting functions on a ball"
	depends on PINCTRL_ASPEED_G7
	help
	  Track the function selected on each ball and reject a pin state that
	  selects a different function on a ball already in use. The table
	  takes 4 bytes of RAM per ball.
```

## drivers/watchdog/Kconfig.aspeed
```kconfig
# Copyright (c) 2026 ASPEED Technology Inc.
# SPDX-License-Identifier: Apache-2.0

config WDT_ASPEED
	bool "ASPEED watchdog driver"
	default y
	depends on DT_HAS_ASPEED_AST2700_WDT_ENABLED
	select SYSCON
	select HAS_WDT_DISABLE_AT_BOOT
	select HAS_WDT_NO_CALLBACKS if !$(dt_compat_any_has_prop,$(DT_COMPAT_ASPEED_AST2700_WDT),interrupts)
	help
	  Enable the watchdog driver for ASPEED SoCs. Timeout callbacks need
	  the watchdog interrupt in the devicetree.
```

## dts/bindings/pinctrl/aspeed,ast2700-soc1-pinctrl.yaml
```yaml
# Copyright (c) 2026 ASPEED Technology Inc.
#
# SPDX-License-Identifier: Apache-2.0

description: |
  ASPEED AST2700 SoC1 (I/O die) pin controller, a child of the SCU1 syscon.

  Each child node describes one pin function on one ball: the SCU1 field
  that selects the function, and the SCU1 fields of the ball's pull-down
  disable and drive strength. The SoC devicetree defines a node for every
  function of every ball, in <aspeed/ast27xx_soc1_pinctrl.dtsi>. A device
  lists the nodes of its pins in pinctrl-N, and a board sets bias-disable
  or drive-strength on a node to configure that pin.

  Register fields are built with ASPEED_G7_PINMUX(reg, bit, func) and
  ASPEED_G7_PINCFG(reg, bit, width) from
  <zephyr/dt-bindings/pinctrl/aspeed-g7-pinctrl.h>.

compatible: "aspeed,ast2700-soc1-pinctrl"

include: base.yaml

properties:
  aspeed,num-balls:
    type: int
    default: 226
    description: |
      Number of ball IDs, AST27XX_SOC1_BALL_NUM. Bounds the aspeed,ball
      values and the table of the ball conflict check.

  aspeed,drive-strength-step-ma:
    type: int
    default: 4
    description: |
      Current per step of a drive-strength field. drive-strength is written
      as drive-strength / step - aspeed,drive-strength-first-step.

  aspeed,drive-strength-first-step:
    type: int
    default: 1
    description: |
      Number of steps encoded by a drive-strength field value of 0.

child-binding:
  description: One pin function on one ball.

  include:
    - name: pincfg-node.yaml
      property-allowlist:
        - bias-disable
        - drive-strength

  properties:
    aspeed,ball:
      type: int
      required: true
      description: |
        Ball ID, AST27XX_SOC1_BALL_<name>. Some IDs stand for a
        controller-wide mode bit rather than a physical ball.

    aspeed,mux:
      type: int
      description: |
        ASPEED_G7_PINMUX() field that selects this function. Omitted on balls
        with a single function.

    aspeed,bias-disable-field:
      type: int
      description: |
        ASPEED_G7_PINCFG() field written with 1 when bias-disable is set.

    aspeed,drive-strength-field:
      type: int
      description: |
        ASPEED_G7_PINCFG() field written with the code of drive-strength.
        drive-strength is in mA and must be a multiple of
        aspeed,drive-strength-step-ma that the field can encode.
```

## dts/bindings/watchdog/aspeed,ast2700-wdt.yaml
```yaml
# Copyright (c) 2026 ASPEED Technology Inc.
# SPDX-License-Identifier: Apache-2.0

description: |
  ASPEED AST2700 watchdog timer.

  A timeout with WDT_FLAG_RESET_CPU_CORE resets the SoC blocks selected by
  the reset mask registers. WDT_FLAG_RESET_SOC resets the full chip; the
  driver then clears the SCU bits that block the watchdog's full-chip reset,
  in the SCUs given by aspeed,scu0 and aspeed,scu1. Timeout callbacks need
  the interrupt.

compatible: "aspeed,ast2700-wdt"

include: base.yaml

properties:
  reg:
    required: true

  aspeed,reset-mask:
    type: array
    description: |
      Values of the reset mask registers, at most 5, in register order.
      Written to the reset masks and the software reset masks at init.
      Without it, the masks are left as the boot firmware set them.

  aspeed,scu0:
    type: phandle
    description: SCU0 syscon, for the full-chip reset gate in SCU0 0xC8 bit 9.

  aspeed,scu1:
    type: phandle
    description: SCU1 syscon, for the full-chip reset gate in SCU1 0xC8 bit 7.
```
